## apps/examples/data_logger/Kconfig
```kconfig
config EXAMPLES_DATA_LOGGER
	tristate "Data Logger with uORB"
	default n
	depends on UORB
	---help---
		Combined UART reader and flash writer using uORB
		publish-subscribe with RTOS threads.
```

## apps/examples/flash_write/Kconfig
```kconfig
config EXAMPLES_FLASH_WRITE
	tristate "Flash Write uORB Subscriber"
	default n
	depends on UORB
	---help---
		Subscribes to uORB topic and writes data to flash.	
```
